## arch/x86/cpu/apollolake/Kconfig
```kconfig
# SPDX-License-Identifier: GPL-2.0
#
# Copyright 2019 Google LLC
#

config INTEL_APOLLOLAKE
	bool
	select FSP_VERSION2
	select HAVE_FSP
	select ARCH_MISC_INIT
	select USE_CAR
	select INTEL_PMC
	select TPL_X86_TSC_TIMER_NATIVE
	select SPL_PCH_SUPPORT
	select TPL_PCH_SUPPORT
	select PCH_SUPPORT
	select P2SB
	imply ENABLE_MRC_CACHE
	imply AHCI_PCI
	imply SCSI
	imply SCSI_AHCI
	imply SPI_FLASH
	imply USB
	imply USB_EHCI_HCD
	imply TPL
	imply SPL
	imply TPL_X86_16BIT_INIT
	imply TPL_OF_PLATDATA
	imply ACPI_PMC
	imply MMC
	imply DM_MMC
	imply MMC_PCI
	imply MMC_SDHCI
	imply CMD_MMC
	imply VIDEO_FSP
	imply PINCTRL_INTEL
	imply PINCTRL_INTEL_APL

if INTEL_APOLLOLAKE

config DCACHE_RAM_BASE
	default 0xfef00000

config DCACHE_RAM_SIZE
	default 0xc0000

config DCACHE_RAM_MRC_VAR_SIZE
	default 0xb0000

config CPU_SPECIFIC_OPTIONS
	def_bool y
	select SMM_TSEG
	select X86_RAMTEST

config SMM_TSEG_SIZE
	hex
	default 0x800000

config MMCONF_BASE_ADDRESS
	hex
	default 0xe0000000

config TPL_SIZE_LIMIT
	default 0x7800

config CPU_ADDR_BITS
	default 39

config APL_SPI_FLASH_BOOT
	bool "Support booting with SPI-flash driver instead memory-mapped SPI"
	select TPL_SPI_FLASH_SUPPORT
	select TPL_SPI_SUPPORT
	help
	  If you want to set BOOT_FROM_FAST_SPI_FLASH to true, enable this
	  option. It enables SPI and SPI flash in TPL. Without the this only
	  available boot method is to use memory-mapped SPI. Since this is
	  actually fast and produces a TPL which is 7KB smaller, it is the
	  default.

endif
```

## cros/Kconfig
```kconfig
# SPDX-License-Identifier: GPL-2.0+
#
# Copyright 2018 Google LLC
#

config CHROMEOS
	bool "Enable Chromium OS verified boot support"
	select BINMAN
	imply CHROMEOS_SPI
	imply NVDATA_CROS_EC
	imply NVDATA_TPM
	imply CROS_FLAG
	imply CROS_FLAG_GPIO
	imply CROS_FLAG_CONST
	imply CROS_FLAG_KEY
	imply LZ4
	imply SPL_LZ4
	imply BLOBLIST
	imply NVDATA_CMOS if X86
	imply FWSTORE_SPI_FLASH

config VBOOT2
	bool "Use Chromium OS vboot2 API where possible"
	depends on CHROMEOS
	default y
	help
	  Use vboot 2 API. This currently (August 2018) only supports the
	  firmware selection process. It cannot be used for selecing and
	  booting a kernel. The current U-Boot implementation only supports
	  the vboot 2 API for firmware, so this option is required to be
	  enabled.

config VBOOT_DISABLE_DEV_ON_RECOVERY
	bool "Disable developer mode when going into recovery"
	depends on CHROMEOS

config VBOOT_DEBUG
	bool "Enable debugging for vboot"
	depends on CHROMEOS
	default y

config SPL_CHROMEOS
	bool "Enable Chromium OS verified boot support in SPL"
	depends on CHROMEOS
	select SUPPORT_SPL
	imply SPL
	imply SPL_SEPARATE_BSS
	imply SPL_DRIVERS_MISC_SUPPORT
	imply SPL_GPIO_SUPPORT
	imply SPL_LIBCOMMON_SUPPORT
	imply SPL_LIBGENERIC_SUPPORT
	imply SPL_SERIAL_SUPPORT
	imply SPL_SPI_FLASH_SUPPORT
	imply SPL_SPI_SUPPORT
	imply SPL_LOG
	imply SPL_BLOBLIST
	imply SPL_BOARD_INIT
	imply SPL_ENV_SUPPORT
	imply SPL_OF_CONTROL
	imply SPL_DM
	imply SPL_REGMAP
	imply SPL_SYSCON
	imply SPL_CROS_EC
	imply SPL_TIMER
	imply SPL_FWSTORE_SPI_FLASH

config TPL_CHROMEOS
	bool "Enable Chromium OS verified boot support in TPL"
	depends on CHROMEOS
	select SUPPORT_TPL
	imply TPL
	imply TPL_LIBCOMMON_SUPPORT
	imply TPL_LIBGENERIC_SUPPORT
	imply TPL_LOG
	imply TPL_BLOBLIST
	imply TPL_SYS_MALLOC_SIMPLE
	imply TPL_HASH_SUPPORT
	imply TPL_GPIO_SUPPORT
	imply TPL_BOARD_INIT
	imply TPL_DRIVERS_MISC_SUPPORT
	imply TPL_ENV_SUPPORT
	imply TPL_SERIAL_SUPPORT
	imply TPL_SPI_FLASH_SUPPORT
	imply TPL_SPI_SUPPORT
	imply TPL_REGMAP
	imply TPL_SYSCON
	imply TPL_OF_CONTROL
	imply TPL_DM
	imply TPL_INPUT
	imply TPL_DM_KEYBOARD
	imply TPL_CROS_EC_KEYB
	imply TPL_CROS_EC
	imply TPL_TIMER
	imply TPL_TPM
	imply TPL_CHROMEOS
	imply TPL_NVDATA_TPM
	imply TPL_FWSTORE_SPI_FLASH

config CROS_FULL
	bool "Build full Chromium OS support"
	default y

config CHROMEOS_TEST
	bool "Enable Chromium OS tests"
	help
	  There are currently no tests specifically for the Chromium OS boot
	  flow, other than the large functional test of running it in sandbox.
	  This option currently does nothing, but the intention is that it will
	  enable building unit tests for each piece of functionality.

config CROS_EC_RW_FILE
	string "Chromium OS EC read-write image filename"
	default "ec-rw.bin"
	help
	  This is the name of the file containing the Embedded Controller (EC)
	  Read-Write image. This is synced to the EC using a process called
	  'software sync' to ensure that the EC is always running the latest
	  software.

source "cros/cmd/Kconfig"
source "cros/flag/Kconfig"
source "cros/fwstore/Kconfig"
source "cros/nvdata/Kconfig"
```

## cros/dts/bindings/fwstore.txt
```
Chromium OS Verified Firmware Store
===================================

The device tree nodes which describes the Chromium OS firmware store are as
follows:

Required properties :
- compatible = "google,fwstore-spi" or google,fwstore-mmc
- firmware-storage : phandle pointing to the SPI or MMC device


Example
=======

	fwstore-spi {
		compatible = "cros,fwstore-spi";
		firmware-storage = <&fwstore_spi>;
	};

	spi@0 {
		#address-cells = <1>;
		#size-cells = <0>;
		reg = <0 0>;
		compatible = "sandbox,spi";
		cs-gpios = <0>, <&gpio_a 0>;
		fwstore_spi: flash@0 {
			reg = <0>;
			compatible = "spansion,m25p128", "spi-flash";
			spi-max-frequency = <40000000>;
			sandbox,filename = "spi.bin";
			emul {
				compatible = "sandbox,spi-flash-emul";
			};
		};
	};
```

## cros/dts/bindings/vboot-flags.txt
```
Chromium OS Verified Boot Flags
===============================

The device tree nodes which describes the Chromium OS vboot flags are as
follows:


Constant
--------

Required properties :
- compatible = "google,const-flag"
- value : Integer value of value (0 or 1)


GPIO
----

Required properties :
- compatible = "google,gpio-flag"
- gpio : phandle indicating the GPIO to use


Optional properties :
- sandbox-value : Value to set the GPIO to on initial startup (0 or 1). Only
     sandbox allows setting these values, since it has a emulated GPIO system.


Key
---

Required properties :
- compatible = "google,key-flag"
- key : Key code number to use (#include <linux/input.h> to get these)


Sysinfo
-------

Required properties :
- compatible = "google,sysinfo-flag"
- google,name : Name of GPIO to look up in the sysinfo table


Example
=======

	#include <linux/input.h>

	write-protect {
		compatible = "google,gpio-flag";
		gpio = <&gpio_a 1>;
	};
	developer {
		compatible = "google,const-flag";
		value = <1>;
	};
	vboot-flag-lid-open {
		compatible = "google,sysinfo-flag";
		google,name = "lid";
	};
	power-off {
		compatible = "google,key-flag";
		key = <KEY_PAUSE>;
	};
	oprom-loaded {
		compatible = "google,const-flag";
		value = <0>;
	};
	ec-in-rw {
		compatible = "google,gpio-flag";
		gpio = <&gpio_a 3>;
	};
```

## cros/flag/Kconfig
```kconfig
# SPDX-License-Identifier: GPL-2.0+
#
# Copyright 2018 Google LLC
#

config CROS_FLAG
	bool "Chromium OS verified boot flags"
	depends on DM
	help
	  Chromium OS includes a number of features which are controlled by
	  hardware such as GPIOs or TPM settings. This uclass implements a
	  way of reading these 'vboot' flags, with the each driver advertising
	  the flags it can read and a method for reading those flags.

	  Flags are normally read using vboot_flag_read_walk(). This checks each
	  driver to find the one that implements the requested flag.

	  Typically the flag values do not change value over the course of a
	  boot, but this is not always true. For example, VBOOT_FLAG_LID_OPEN
	  is 1 when the lid is open on a clamshell device, and 0 if the lid is
	  closed. In this case vboot_flag_read_walk_prev() can be used to read
	  the current value of the flag, along with the previous value. This
	  allows transitions to be detected.

config CROS_FLAG_GPIO
	bool "Flags controlled by a GPIO"
	depends on CROS_FLAG
	help
	  Enable support for a Chromium OS flag which is controlled by a GPIO.
	  The flag is 1 if the GPIO is high and 0 if the GPIO is low.

	  For sandbox only, the initial value of the flag can be provided in
	  the device tree, for testing purposes.

config CROS_FLAG_CONST
	bool "Flags controlled by a constant"
	depends on CROS_FLAG
	help
	  Enable support for a Chromium OS flag which is always the same value,
	  as specified by the device-tree node. The value does not change at
	  all over the life of the verified boot session. This can be useful
	  for flags which are not supported on a particular platform.

config CROS_FLAG_KEY
	bool "Flags controlled by a keypress"
	depends on CROS_FLAG && SANDBOX
	help
	  Enable support for a Chromium OS flag which is controlled by a
	  keypress captured early during start-up. This is only provided for
	  use with sandbox. A short delay at start-up allows capturing the
	  keys to be read by this driver - see cros_ec_check_keyboard().

config CROS_FLAG_SYSINFO
	bool "Flags controlled by coreboot sysinfo"
	depends on CROS_FLAG && X86
	help
	  Enable support for a Chromium OS flag which is controlled by
	  information received by coreboot in its 'sysinfo' structure. This is
	  used when coreboot is the first bootloader and it chain-loads into
	  U-Boot. Since many of the flags can only be read very early in boot,
	  this provides a way to keep a consistent flag value throughout the
	  boot.
```

## cros/fwstore/Kconfig
```kconfig
# SPDX-License-Identifier: GPL-2.0+
#
# Copyright 2018 Google LLC
#

config FWSTORE_SPI_FLASH
	bool "Firmware storage driver that uses SPI flash"
	help
	  This provides a driver for firmware storage that uses SPI flash.
	  The device typically has a read-only portion (controlled by a write-
	  protect pin and block-protect pins in the SPI-flash status register)
	  and a read-write portion. The latter is used to store upgradeable
	  parts of the firmware.

config SPL_FWSTORE_SPI_FLASH
	bool "Firmware storage driver that uses SPI flash in SPL"
	help
	  This provides a driver for firmware storage that uses SPI flash.
	  The device typically has a read-only portion (controlled by a write-
	  protect pin and block-protect pins in the SPI-flash status register)
	  and a read-write portion. The latter is used to store upgradeable
	  parts of the firmware.

config TPL_FWSTORE_SPI_FLASH
	bool "Firmware storage driver that uses SPI flash in TPL"
	help
	  This provides a driver for firmware storage that uses SPI flash.
	  The device typically has a read-only portion (controlled by a write-
	  protect pin and block-protect pins in the SPI-flash status register)
	  and a read-write portion. The latter is used to store upgradeable
	  parts of the firmware.

config VPL_FWSTORE_SPI_FLASH
	bool "Firmware storage driver that uses SPI flash in VPL"
	help
	  This provides a driver for firmware storage that uses SPI flash.
	  The device typically has a read-only portion (controlled by a write-
	  protect pin and block-protect pins in the SPI-flash status register)
	  and a read-write portion. The latter is used to store upgradeable
	  parts of the firmware.

config FWSTORE_MMC
	bool "Firmware storage driver that uses MMC"
	help
	  This provides a driver for firmware storage that uses MMC. This is
	  an experimental feature which has not yet been shipped in a
	  Chromebook. The write-protection logic in MMC chips typically does
	  not provided an external hardware pin to control it, which makes it
	  hard to implement Chromium OS verified boot with MMC.
```

## cros/nvdata/Kconfig
```kconfig
config NVDATA_CROS_EC
	bool "Non-volatile data driver that uses the Chromium OS EC"
	help
	  This stored non-volatile data in the EC. This data may be lost when
	  the EC is reset but that does not happen often (Esc-Power-Refresh,
	  running out of battery, etc.). This driver supports only the
	  CROS_NV_DATA type.

config NVDATA_TPM
	bool "Non-volatile data driver that uses the TPM"
	help
	  This stored non-volatile data in the EC. This data is retained until
	  the TPM is reset and cleared, typically after a 'power wash' cycle
	  causes the device to enter the initial OOBE (Out-of-Box-Experience)
	  screen. This driver supports CROS_NV_SECDATA, CROS_NV_SECDATAK and
	  CROS_NV_REC_HASH types.

config SPL_NVDATA_TPM
	bool "Non-volatile data driver that uses the TPM in SPL"
	help
	  Enables support for storing NV data in the TPM within SPL. This must
	  normally be enabled since SPL typically accesses the data to find
	  out what action to take.

	  For sandbox there is a little quirk in that the TPM driver only
	  writes its data to the state.dtb file if it has been probed, so this
	  option generally must be enabled within SPL even if the driver is not
	  actually used. Otherwise the data is lost when jumping to U-Boot
	  proper.

config TPL_NVDATA_TPM
	bool "Non-volatile data driver that uses the TPM in TPL"
	help
	  Enables support for storing NV data in the TPM within TPL. This must
	  normally be enabled if TPL typically accesses the data to find
	  out what action to take - e.g. whether to jump to the A SPL or the B
	  SPL.

config VPL_NVDATA_TPM
	bool "Non-volatile data driver that uses the TPM in VPL"
	help
	  Enables support for storing NV data in the TPM within VPL. This must
	  normally be enabled since VPL typically accesses the data to find
	  out what action to take - e.g. whether to jump to the A SPL or the B
	  SPL.

config NVDATA_CMOS
	bool "Non-volatile data driver that uses CMOS RAM"
	select DM_RTC
	help
	  For devices which have battery-backed CMOS RAM it is possible to
	  store non-volatile data into this instead of the EC. This data is
	  preserved so long as the Real-Time Clock (RTC) retains power.
	  Typically this survives even an EC restart. This driver supports only
	  the CROS_NV_DATA type.

config VPL_NVDATA_CMOS
	bool "Non-volatile data driver that uses CMOS RAM in VPL"
	select VPL_DM_RTC
	select VPL_RTC_SUPPORT
	help
	  For devices which have battery-backed CMOS RAM it is possible to
	  store non-volatile data into this instead of the EC. This data is
	  preserved so long as the Real-Time Clock (RTC) retains power.
	  Typically this survives even an EC restart. This driver supports only
	  the CROS_NV_DATA type.
```
