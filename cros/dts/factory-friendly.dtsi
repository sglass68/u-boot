// SPDX-License-Identifier: GPL-2.0+
/*
 * GBB flags to enable factory-friendly features, defined in
 * vboot_reference/firmware/include/gbb_header.h
 *
 * Copyright 2018 Google LLC
 */

/ {
	chromeos-config {
		gbb-flag-dev-screen-short-delay;
		gbb-flag-force-dev-switch-on;
		gbb-flag-force-dev-boot-usb;
		gbb-flag-disable-fw-rollback-check;
	};
};
